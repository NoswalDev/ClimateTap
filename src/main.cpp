
/*
Climate Tap:
AA Canbus Components
  Bits are additive.
  (1)Fan Level - ID:1C810066 - Bits: D6 D7
        0 | 00 00 |
      1-9 | 00 5A | 00 6A | 00 7B | 00 8C | 00 9D | 00 AE | 00 BF | 00 D0 | 00 E1 |
    10-18 | 00 F1 | 01 02 | 01 13 | 01 24 | 01 35 | 01 46 | 01 57 | 01 68 | 01 A4 |
  (10)Recirculate - ID:1C810066 - Bits: D6
    Off | 00 |
     On | C8 |
  (3)Temp Up, (4)Temp Down
  Vent (5)Top, (6)Mid, (7)Bottom
  Defrost (8)Front, (9)Rear
  (11)AC Status
D General Feature
  Adjust text for readability
    -Poll light sensor, invert display if necessary
    -Starting animation
  Start car with fan off, AC off, vents default, etc
  Adafruit GFX library too slow. Clear stuff for faster startup.
A Fan Display
    *0-18
    *Display OFF instead of zero
      //FAN OFF displayed at minimum level
    -Don't display inactive fan animation at 0 fan speed
      //Displaying OFF removes fan icon and obfuscates the dial
  Display Auto Symbol
    *Might be too small to display bar graph
    *Use large numbers when adjusting
    *Switch to fan animation icon during Long_Delay
    *Fan level correlates to animation speed
B temp Control Display
  Check car for temp sensors
  Correlate temp sensors and displayed temperature
  Add Fahrenheit number conversion option
    *In celsius
    %Lo to num to Hi
      //LO only displayed when either fan or AC is on. Otherwise, snowflake.
    *Low display as snowflake
    *Hi display as fire
    *Anything else displays in Celsius
  Low with AC off: no snowflake symbol, outside ambient temp display
    *Low with AC on: snowflake symbol on low IF FAN ON
C Auto Control Button
  Exterior temp polling
  Interior temp polling
  Interior Humidity polling
  Vent control
  Recirculation control
  AC control
  Control Override function
  Control Modes
    Auto-detect defrost needed for front and rear
    Auto-detect if possible to use cooler outside air instead of AC
      Switch to AC on if humidity too high
    Auto-detect if moisture level too high or low
    Auto-detect if in need of rapid temp change, focus on directing air to passenger

*/
#include <Arduino.h>
#include <Wire.h>
#include <SPI.h>
#include <Adafruit_GFX.h>
#include <Adafruit_SSD1306.h>
#include <HGC17pt7b.h>
#include <mcp2515_can.h>
#include <avr/wdt.h>

//canbus
volatile bool new_stat = false;
mcp2515_can CAN(10); //SPI CS Pin
volatile uint8_t len = 0;
volatile uint8_t rxb0[8];
uint8_t canbuffer[8];


// volatile uint8_t rxb1[8];

//sys wide
#define Long_Delay 40
#define Short_Delay 8
#define Temp_High 32
#define Temp_Low 14
#define Fan_Steps 18 //0 to Fan_Steps

int16_t x1, y1;
uint16_t w, h;

uint8_t fan_spd = 0;
uint8_t fan_ani_frame = 0;
uint8_t fan_ani_tmr = 0;
uint8_t fan_stby_tmr = 0;

uint8_t temp = Temp_Low;
uint8_t temp_abs = 0;
uint8_t temp_ani_frame = 0;
uint8_t temp_ani_tmr = 0;
uint8_t therm_lvl = 0;

volatile bool ac_stat = true; 
volatile bool aac_stat = false;
bool recirc_stat = false;
uint8_t fan_stat = 0;
uint8_t temp_stat = Temp_Low;
// volatile uint8_t &fan_stat = rxb0[2]; //reference(&) to mcu msg buffer
// volatile uint8_t &temp_stat = rxb0[4];

//animation
const uint8_t Fan_Bitmap[6] [288] PROGMEM = {
  {
    0x00, 0x00, 0x00, 0x00, 0x00, 0x00, 0x00, 0x00, 0x00, 0x00, 0x00, 0x00, 0x00, 0x00, 0x00, 0x00, 
    0x00, 0x00, 0x00, 0x0f, 0xc0, 0x03, 0xf0, 0x00, 0x00, 0x7f, 0xe0, 0x0f, 0xfe, 0x00, 0x00, 0xf0, 
    0x70, 0x3c, 0x0f, 0x00, 0x01, 0xc0, 0x38, 0x78, 0x03, 0x80, 0x03, 0x80, 0x18, 0x60, 0x01, 0xc0, 
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    0x00, 0x00, 0x00, 0x00, 0x00, 0x00, 0x00, 0x00, 0x00, 0x00, 0x00, 0x00, 0x00, 0x00, 0x00, 0x00
  },
  {
    0x00, 0x00, 0x00, 0x00, 0x00, 0x00, 0x00, 0x00, 0x00, 0x1f, 0x80, 0x00, 0x00, 0x00, 0x00, 0xff, 
    0xf0, 0x00, 0x00, 0x00, 0x01, 0xe0, 0x78, 0x00, 0x00, 0x00, 0x03, 0x80, 0x1e, 0x00, 0x00, 0x00, 
    0x03, 0x00, 0x07, 0x00, 0x00, 0xfe, 0x06, 0x00, 0x03, 0x80, 0x03, 0xff, 0x06, 0x00, 0x01, 0x80, 
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    0xff, 0x00, 0x00, 0x00, 0x00, 0x01, 0xf8, 0x00, 0x00, 0x00, 0x00, 0x00, 0x00, 0x00, 0x00, 0x00
  },
  {
    0x00, 0x00, 0x01, 0xfe, 0x00, 0x00, 0x00, 0x00, 0x07, 0xff, 0x80, 0x00, 0x00, 0x00, 0x1e, 0x01, 
    0xe0, 0x00, 0x00, 0x00, 0x3c, 0x00, 0x70, 0x00, 0x00, 0x00, 0x30, 0x00, 0x38, 0x00, 0x00, 0x00, 
    0x70, 0x00, 0x1c, 0x00, 0x00, 0x00, 0x60, 0x00, 0x0c, 0x00, 0x00, 0x00, 0x60, 0x00, 0x0c, 0x00, 
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    0x80, 0x78, 0x00, 0x00, 0x00, 0x01, 0xff, 0xe0, 0x00, 0x00, 0x00, 0x00, 0x7f, 0x80, 0x00, 0x00
  },
  {
    0x00, 0x00, 0x1f, 0xf8, 0x00, 0x00, 0x00, 0x00, 0x7e, 0x7e, 0x00, 0x00, 0x00, 0x00, 0xe0, 0x07, 
    0x80, 0x00, 0x00, 0x01, 0xc0, 0x03, 0x80, 0x00, 0x00, 0x03, 0x80, 0x01, 0xc0, 0x00, 0x00, 0x07, 
    0x00, 0x00, 0xc0, 0x00, 0x00, 0x06, 0x00, 0x00, 0xc0, 0x00, 0x00, 0x06, 0x00, 0x00, 0x40, 0x00, 
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    0xe0, 0x07, 0x00, 0x00, 0x00, 0x00, 0x7e, 0x7e, 0x00, 0x00, 0x00, 0x00, 0x1f, 0xf8, 0x00, 0x00
  },
  {
    0x00, 0x00, 0x7f, 0x80, 0x00, 0x00, 0x00, 0x01, 0xff, 0xe0, 0x00, 0x00, 0x00, 0x07, 0x80, 0x70, 
    0x00, 0x00, 0x00, 0x0e, 0x00, 0x38, 0x00, 0x00, 0x00, 0x1c, 0x00, 0x1c, 0x00, 0x00, 0x00, 0x38, 
    0x00, 0x0c, 0x00, 0x00, 0x00, 0x30, 0x00, 0x0c, 0x00, 0x00, 0x00, 0x70, 0x00, 0x0c, 0x00, 0x00, 
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    0x0e, 0x01, 0xe0, 0x00, 0x00, 0x00, 0x07, 0xff, 0x80, 0x00, 0x00, 0x00, 0x01, 0xfe, 0x00, 0x00
  },
  {
    0x00, 0x00, 0x00, 0x00, 0x00, 0x00, 0x00, 0x01, 0xfc, 0x00, 0x00, 0x00, 0x00, 0x0f, 0xfe, 0x00, 
    0x00, 0x00, 0x00, 0x1e, 0x07, 0x00, 0x00, 0x00, 0x00, 0x78, 0x03, 0x80, 0x00, 0x00, 0x00, 0xe0, 
    0x01, 0x80, 0x00, 0x00, 0x00, 0xc0, 0x01, 0x80, 0xff, 0x00, 0x01, 0x80, 0x00, 0x83, 0xef, 0x80, 
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    0x00, 0x7f, 0xf0, 0x00, 0x00, 0x00, 0x00, 0x3f, 0x80, 0x00, 0x00, 0x00, 0x00, 0x00, 0x00, 0x00
  }
};
const uint8_t Therm_Bitmap[1] [96] PROGMEM = {
  0x07, 0xe0, 0x0f, 0xf0, 0x1c, 0x38, 0x38, 0x1c, 0x30, 0x0c, 0x30, 0x0c, 0x30, 0x0c, 0x30, 0x0c, 
	0x30, 0x0c, 0x30, 0x0c, 0x30, 0x03, 0x30, 0x03, 0x30, 0x0c, 0x30, 0x0c, 0x30, 0x0c, 0x30, 0x0c, 
	0x30, 0x0c, 0x30, 0x0c, 0x30, 0x03, 0x30, 0x03, 0x30, 0x0c, 0x30, 0x0c, 0x30, 0x0c, 0x30, 0x0c, 
	0x30, 0x0c, 0x30, 0x0c, 0x30, 0x03, 0x30, 0x03, 0x30, 0x0c, 0x30, 0x0c, 0x30, 0x0c, 0x30, 0x0c, 
	0x30, 0x0c, 0x30, 0x0c, 0x30, 0x0c, 0x30, 0x0c, 0x63, 0xc6, 0xe7, 0xe7, 0xcf, 0xf3, 0xcf, 0xf3, 
	0xcf, 0xf3, 0xcf, 0xf3, 0xe7, 0xe7, 0x63, 0xc6, 0x70, 0x0e, 0x3c, 0x3c, 0x1f, 0xf8, 0x07, 0xe0
};
const uint8_t Snow_Bitmap[2] [288] PROGMEM = {
  {0x00, 0x00, 0x00, 0x60, 0x00, 0x00, 0x00, 0x00, 0x00, 0x60, 0x00, 0x00, 0x00, 0x00, 0x0c, 0x60, 
    0x00, 0x00, 0x00, 0x00, 0x0e, 0x67, 0x00, 0x00, 0x00, 0x00, 0x07, 0x6f, 0x00, 0x00, 0x00, 0x00, 
    0x03, 0xfe, 0x00, 0x00, 0x00, 0x00, 0x01, 0xf8, 0x00, 0x00, 0x00, 0x60, 0x00, 0xf0, 0x00, 0x00, 
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    0x06, 0x30, 0x00, 0x00, 0x00, 0x00, 0x06, 0x00, 0x00, 0x00, 0x00, 0x00, 0x06, 0x00, 0x00, 0x00
  },
  {0x00, 0x00, 0x06, 0x00, 0x00, 0x00, 0x00, 0x00, 0x06, 0x00, 0x00, 0x00, 0x00, 0x00, 0x06, 0x30, 
    0x00, 0x00, 0x00, 0x00, 0xe6, 0x70, 0x00, 0x00, 0x00, 0x00, 0xf6, 0xe0, 0x00, 0x00, 0x00, 0x00, 
    0x7f, 0xc0, 0x00, 0x00, 0x00, 0x00, 0x1f, 0x80, 0x00, 0x00, 0x00, 0x00, 0x0f, 0x00, 0x06, 0x00, 
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    0x0c, 0x60, 0x00, 0x00, 0x00, 0x00, 0x00, 0x60, 0x00, 0x00, 0x00, 0x00, 0x00, 0x60, 0x00, 0x00
  }
};
const uint8_t Fire_Bitmap[2] [288] PROGMEM = {
  {0x00, 0x00, 0x00, 0x80, 0x00, 0x00, 0x00, 0x00, 0x03, 0x80, 0x00, 0x00, 0x00, 0x00, 0x0f, 0x80, 
    0x00, 0x00, 0x00, 0x00, 0x1f, 0x80, 0x00, 0x00, 0x00, 0x00, 0x3f, 0x80, 0x00, 0x00, 0x00, 0x00, 
    0x7f, 0x80, 0x00, 0x00, 0x00, 0x00, 0x7f, 0x80, 0x00, 0x00, 0x00, 0x00, 0xff, 0xc0, 0x00, 0x00, 
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    0x00, 0x01, 0xc0, 0x00, 0x00, 0x18, 0x00, 0x01, 0x80, 0x00, 0x00, 0x00, 0x00, 0x02, 0x00, 0x00
  },
  {0x00, 0x00, 0x40, 0x00, 0x00, 0x00, 0x00, 0x00, 0x70, 0x00, 0x00, 0x00, 0x00, 0x00, 0x7c, 0x00, 
    0x00, 0x00, 0x00, 0x00, 0x7e, 0x00, 0x00, 0x00, 0x00, 0x00, 0x7f, 0x00, 0x00, 0x00, 0x00, 0x00, 
    0x7f, 0x80, 0x00, 0x00, 0x00, 0x00, 0x7f, 0x80, 0x00, 0x00, 0x00, 0x00, 0xff, 0xc0, 0x00, 0x00, 
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    0x00, 0x07, 0x00, 0x00, 0x00, 0x60, 0x00, 0x06, 0x00, 0x00, 0x00, 0x10, 0x00, 0x00, 0x00, 0x00
  }
};

//displays
#define OLED_RESET 0 // GPIO0
// Adafruit_SSD1306 dsp0(128,64);
// Adafruit_SSD1306 dsp1(128,64);
// Adafruit_SSD1306 dsp2(128,64);
Adafruit_SSD1306 dsp1(OLED_RESET);
Adafruit_SSD1306 dsp2(OLED_RESET);

//SPI
// SPISettings SPISET(20000000,MSBFIRST,SPI_MODE0);

void IRQ2(){
  CAN.readMsgBuf(&len, rxb0); //save to mcu & clear MCP buffer
  // Serial.println("int");
  new_stat = true; //flip msg read trigger
}
void IRQ3(){
  aac_stat = !aac_stat;
}
void displaySetup(){
  dsp1.begin(SSD1306_SWITCHCAPVCC, 0x3C); 
  dsp2.begin(SSD1306_SWITCHCAPVCC, 0x3D); //SSD1306_EXTERNALVCC or SSD1306_SWITCHCAPVCC
  dsp1.setTextColor(WHITE);
  dsp1.setFont(&HGC17pt7b);
  dsp1.setTextSize(1);
  dsp2.setTextColor(WHITE);
  dsp2.setFont(&HGC17pt7b);
  dsp1.setTextSize(1);
  dsp1.clearDisplay(); //clears the only available display buffer, which is shared by DSP1 and DSP2
  dsp1.display();
  dsp2.display();
}
void showFanAnimation(){
  dsp1.clearDisplay();
  if (fan_spd != fan_stat){
    fan_spd = fan_stat;
    fan_stby_tmr = Long_Delay;
  }
  if(fan_stby_tmr > 0){
    fan_stby_tmr--;
    if(fan_spd == Fan_Steps){
      // dsp1.setTextSize(1);
      dsp1.setCursor(2,23);
      dsp1.print("MAX");
      dsp1.setCursor(3, 48);
      dsp1.print("FAN");
    }
    else if(fan_spd == 0){
      // dsp1.setTextSize(1);
      dsp1.setCursor(4,23);
      dsp1.print("FAN");
      dsp1.setCursor(4,48);
      dsp1.print("OFF");
    }
    else{
      dsp1.setTextSize(1);
      dsp1.getTextBounds(String(fan_spd),0,0, &x1, &y1, &w, &h);
      dsp1.setCursor((64-w)>>1,35);
      dsp1.print(fan_spd);
    }
  }
  else{
    if(fan_spd == 0){
      dsp1.drawBitmap(8,0,Fan_Bitmap[0], 48,48,1);
    }
    else{
      drawFanFrame(8,0);
      // if(fan_spd == Fan_Steps){
      //   dsp1.setCursor(0, 20);
      //   dsp1.setTextSize(3);
      //   dsp1.print("MAX");
      // }
    }
    if(fan_spd == Fan_Steps){
      dsp1.fillCircle(3,3,3,1);
    }
  }
  dsp1.display();
}
void showTempAnimation(){
  dsp2.clearDisplay();
  if (temp != temp_stat){
    temp = temp_stat;
    temp_abs = temp - Temp_Low;
  }
  dsp2.drawBitmap(48,0,Therm_Bitmap[0],16,48,1); //thermometer symbol
  switch(temp_abs){ //determine bar level and animations
    case 1 ... 4:
      therm_lvl = temp_abs;
      drawTempFrame(1,0,0);
      break;
    case 5 ... 17:
      therm_lvl = 2*temp_abs-4;
      drawTempFrame(1,0,0);
      break;
    case Temp_High - Temp_Low:
      therm_lvl = 31;
      drawTempFrame(2,0,0);
      break;
    default:
      therm_lvl = 0;
      drawTempFrame(0,0,0);
      break;
  }
  dsp2.fillRect(54, 36-therm_lvl, 4, therm_lvl, 1);
  dsp2.display();
}
// void newStatus(){ //push climate status to displays
//   fan_stat = rxb0[2];
//   temp_stat = rxb0[4];
//   ac_stat = true;
//   //read message
//   //update proper item
// }
void drawFanFrame(uint8_t x, uint8_t y){
  dsp1.drawBitmap(x,y,Fan_Bitmap[fan_ani_frame], 48,48,1);
  fan_ani_tmr++;
  if (fan_ani_tmr > fanAniDelay()){
    fan_ani_tmr = 0;
    fan_ani_frame++;
    if (fan_ani_frame > 5){
      fan_ani_frame=0;
    }
  }
}
uint8_t fanAniDelay(){
  return (Fan_Steps - fan_spd)>>2;
}

void drawTempFrame(uint8_t stat, uint8_t x, uint8_t y){
  //handles snow(0), fire(2), and thermo blinker(1) and num display
  switch(stat){
    case 0:
      if(fan_spd > 0 && ac_stat){ //fan off, ac off
        dsp2.drawBitmap(x,y,Snow_Bitmap[temp_ani_frame],48,48,1);
      }
      else{
        // dsp2.setTextSize(1);
        dsp2.setCursor(8,35);
        dsp2.print("LO");
      }
      break;
    case 2:
      dsp2.drawBitmap(x,y,Fire_Bitmap[temp_ani_frame],48,48,1);
      dsp2.drawFastHLine(55, 4, 2, 1); //solid therm top pixel hardcoded
      break;
    default:
      if(temp_ani_frame){ //blinky
        dsp2.drawFastHLine(55, 35-therm_lvl, 2, 1);
      }
      // dsp2.setTextSize(3);
      // dsp2.setCursor(5,12);
      // dsp2.setTextSize(1);
      dsp2.fillCircle(43, 15, 4, 1);
      dsp2.fillCircle(43, 15, 2, 0);
      dsp2.getTextBounds(String(temp),0,48, &x1, &y1, &w, &h);
      dsp2.setCursor(37-w,35);
      dsp2.print(temp);
      // Serial.print(w);
      // Serial.print(" - ");
      // dsp2.getTextBounds(String(temp%10),0,48, &x1, &y1, &w, &h);
      // dsp2.setCursor(36-w,36);
      // dsp2.print(temp%10);
      // Serial.println(w);
      break;
  }
  temp_ani_tmr++;
  if (temp_ani_tmr > Short_Delay){
    temp_ani_tmr = 0;
    temp_ani_frame ^= 1; //xor flipped
  }
}
void checkDisplays(){
  Wire.beginTransmission(0x3C);
  if(Wire.endTransmission()){
    dsp1.begin(SSD1306_SWITCHCAPVCC, 0x3C);
    dsp1.clearDisplay();
    dsp1.display();
    Serial.println("DSP1 reset");
    while(1);
  }
  Wire.beginTransmission(0x3D);
  if(Wire.endTransmission()){
    dsp2.begin(SSD1306_SWITCHCAPVCC, 0x3D); 
    dsp2.clearDisplay();
    dsp2.display();
    Serial.println("DSP2 reset");
    while(1);
  }
}

void setup() {
  //watchdog
  wdt_enable(WDTO_2S);
  //Interrupt routine
  pinMode(2, INPUT_PULLUP);
  attachInterrupt(digitalPinToInterrupt(2), IRQ2, FALLING);
  pinMode(3, INPUT_PULLUP);
  attachInterrupt(digitalPinToInterrupt(3), IRQ3, FALLING);
  //SPI
  // SPI.beginTransaction(SPISET);
  //canbus setup
  while (CAN.begin(CAN_125KBPS, MCP_8MHz)) { //CAN.begin() returns 0 on pass, 1 on fail
    // stall for watchdog interrupt to trigger reset
    // run graphic to indicate failure to user
    displaySetup();
    while(1){
      dsp1.clearDisplay();
      dsp1.setCursor(4, 23);
      dsp1.print("CAN");
      dsp1.setCursor(3, 48);
      dsp1.println("FAIL");
      dsp1.display();
      dsp2.display();
    }
  }
  //Receive Buffer(RXB) Masks(RXM)(on/off switch for filters) & Filters(RXF)(on/off switch for messages)
  CAN.init_Mask(0, 1, 0b11111111); //RXB0{RXM0: RXF0, RXF1}
  CAN.init_Filt(0, 1, 0x1C810066); 
  CAN.init_Filt(1, 1, 0x7FFFFFFF);
  CAN.init_Mask(1, 1, 0b11111111); //RXB1{RXM1: RXF2, RXF3, RXF4, RXF5}
  CAN.init_Filt(2, 1, 0x7FFFFFFF);
  CAN.init_Filt(3, 1, 0x7FFFFFFF);
  CAN.init_Filt(4, 1, 0x7FFFFFFF);
  CAN.init_Filt(5, 1, 0x7FFFFFFF);
  // Serial.begin(115200);
  //display(s) setup
  // Wire.begin(0x3A); //optional
  displaySetup();

  //starting comments
  /*
    send fan down command until fan off or safety counter reached
    send temp down command until min or safety counter reached
    send vent commands until default status set
  */
}

void loop() {
  //watchdog reset
  wdt_reset();
  if(new_stat){
    //run number conversions
    new_stat = false;
    fan_stat = max(0,(rxb0[6]%2)*16 + (rxb0[7]>>4) - 4);
    fan_stat -= !!(fan_stat>>3);
    fan_stat = min(fan_stat, 18);
    recirc_stat = rxb0[6]>>3 == 0b11001;
  }
  showFanAnimation();
  showTempAnimation();
  // Serial.println(analogRead(inputPin));
  //display status check
  checkDisplays();
}